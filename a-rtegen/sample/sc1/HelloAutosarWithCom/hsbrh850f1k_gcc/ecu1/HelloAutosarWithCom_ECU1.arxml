AUTOSAR XML (schema 4-0-3)
package /Ecuc
  module config Os: ecuc-def-edition=4.2.0, implementation-config-variant=VARIANT-PRE-COMPILE
    MainApp (OsAppMode)
    OsOS: OsStackMonitoring=true, OsStatus=EXTENDED, OsUseGetServiceId=true, OsUseParameterAccess=true, OsScalabilityClass=SC1
      OsHooks: OsErrorHook=true, OsProtectionHook=true, OsPreTaskHook=false, OsPostTaskHook=false, OsStartupHook=false, OsShutdownHook=false
      OsHookStack: OsHookStackSize=1024
      OsOsStack: OsOsStackSize=8192
    3 x OsTask, all with OsTaskActivation=1, OsTaskSchedule=FULL, OsTaskResourceRef=COMSTACK_RESOURCE:
      TASK1: OsTaskPriority=10, OsTaskStackSize=1024
      ECU_INIT_TASK: OsTaskPriority=15, OsTaskStackSize=1024
        OsTaskAutostart: OsTaskAppModeRef=MainApp
      SCHM_TASK: OsTaskPriority=15
    7 x OsResource:
      COMSTACK_RESOURCE: OsResourceProperty=STANDARD
      COM_REENTRANT{0..2}: OsResourceProperty=LINKED, OsResourceLinkedResourceRef=COMSTACK_RESOURCE
      CANIF_REENTRANT0: OsResourceProperty=LINKED, OsResourceLinkedResourceRef=COMSTACK_RESOURCE
      CANIF_REENTRANT1: OsResourceProperty=LINKED, OsResourceLinkedResourceRef=COMSTACK_RESOURCE
      CAN_REENTRANT: OsResourceProperty=LINKED, OsResourceLinkedResourceRef=COMSTACK_RESOURCE
    ALARM1 (OsAlarm): OsAlarmCounterRef=MAIN_HW_COUNTER
      OsAlarmAction
        OsAlarmActivateTask: OsAlarmActivateTaskRef=TASK1
      OsAlarmAutostart: OsAlarmAutostartType=RELATIVE, OsAlarmAlarmTime=800000, OsAlarmCycleTime=800000, OsAlarmAppModeRef=MainApp
    ALARM2 (OsAlarm): OsAlarmCounterRef=MAIN_HW_COUNTER
      OsAlarmAction
        OsAlarmActivateTask: OsAlarmActivateTaskRef=SCHM_TASK
      OsAlarmAutostart: OsAlarmAutostartType=RELATIVE, OsAlarmAlarmTime=800000, OsAlarmCycleTime=800000, OsAlarmAppModeRef=MainApp
    OsInclude: OsIncludeFileName=Can_Target.h
    C2ISR_FOR_CAN_RX0 (OsIsr): OsIsrCategory=CATEGORY_2, OsIsrInterruptNumber=25, OsIsrInterruptPriority=3, OsIsrInterruptSource=ENABLE, OsIsrResourceRef=COMSTACK_RESOURCE
    C2ISR_FOR_CAN_TX0 (OsIsr): OsIsrCategory=CATEGORY_2, OsIsrInterruptNumber=26, OsIsrInterruptPriority=3, OsIsrInterruptSource=ENABLE, OsIsrResourceRef=COMSTACK_RESOURCE
  module config EcuC: ecuc-def-edition=4.2.0, implementation-config-variant=VARIANT-PRE-COMPILE
    EcucPduCollection: PduIdTypeEnum=UINT16, PduLengthTypeEnum=UINT16
      Pdu1 (Pdu): PduLength=4
  module config Com: ecuc-def-edition=4.2.0, implementation-config-variant=VARIANT-PRE-COMPILE
    ComConfig: ComConfigurationId=0
      ComSignal1 (ComSignal):
        ComHandleId = 0
        ComBitPosition = 0
        ComBitSize = 32
        ComSignalEndianness = LITTLE_ENDIAN
        ComSignalInitValue = 0
        ComSignalType = UINT32
        ComTransferProperty = TRIGGERED
        ComSystemTemplateSystemSignalRef = iSignalToIPduMapping1
      ComIPduGroup1 (ComIPduGroup): ComIPduGroupHandleId=0
      ComIPdu1 (ComIPdu):
        ComIPduDirection = SEND
        ComIPduSignalProcessing = IMMEDIATE
        ComIPduHandleId = 0
        ComIPduType = NORMAL
        ComIPduGroupRef = ComIPduGroup1
        ComIPduSignalRef = ComSignal1
        ComPduIdRef = Pdu1
        ComTxIPdu: ComTxIPduUnusedAreasDefault=0
          ComTxModeTrue
            ComTxMode: ComTxModeMode=DIRECT
      ComTimeBase: ComTxTimeBase=0.1, ComRxTimeBase=0.1
    ComGeneral: ComSupportedIPduGroups=1, ComVersionInfoApi=false, ComConfigurationUseDet=true
  module config PduR: ecuc-def-edition=4.2.0, implementation-config-variant=VARIANT-PRE-COMPILE
    PduRGeneral: PduRZeroCostOperation=true, PduRDevErrorDetect=false, PduRVersionInfoApi=false
    PduRRoutingTables: PduRConfigurationId=0
      PduRRoutingTable: PduRIsMinimumRouting=false
        PduRRoutingPath_0 (PduRRoutingPath)
          PduRSrcPdu: PduRSourcePduHandleId=0, PduRSrcPduRef=Pdu1
          PduRDestPdu: PduRDestPduHandleId=0, PduRDestPduRef=Pdu1
  module config CanIf: ecuc-def-edition=4.2.0, implementation-config-variant=VARIANT-PRE-COMPILE
    CanIfPublicCfg:
      CanIfPublicCancelTransmitSupport = true
      CanIfPublicChangeBaudrateSupport = true
      CanIfPublicDevErrorDetect = true
      CanIfPublicHandleTypeEnum = UINT8
      CanIfPublicMultipleDrvSupport = false
      CanIfPublicNumberOfCanHwUnits = 1
      CanIfPublicPnSupport = false
      CanIfPublicReadRxPduDataApi = true
      CanIfPublicReadRxPduNotifyStatusApi = true
      CanIfPublicReadTxPduNotifyStatusApi = true
      CanIfPublicSetDynamicTxIdApi = false
      CanIfPublicTxBuffering = false
      CanIfPublicTxConfirmPollingSupport = true
      CanIfPublicVersionInfoApi = false
      CanIfPublicWakeupCheckValidSupport = true
    CanIfPrivateCfg: CanIfPrivateDlcCheck=true, CanIfSupportTTCAN=false
    CanIfDispatchCfg:
      CanIfDispatchUserCtrlBusOffName = CanSM_ControllerBusOff
      CanIfDispatchUserCtrlBusOffUL = CAN_SM
      CanIfDispatchUserCtrlModeIndicationName = CanSM_ControllerModeIndication
      CanIfDispatchUserCtrlModeIndicationUL = CAN_SM
      CanIfDispatchUserValidateWakeupEventName = EcuM_ValidateWakeupEvent
      CanIfDispatchUserValidateWakeupEventUL = ECUM
    CanIfCtrlDrvCfg: CanIfCtrlDrvTxCancellation=false, CanIfCtrlDrvInitHohConfigRef=CanIfInitHohCfg, CanIfCtrlDrvNameRef=CanGeneral
      CanIfCtrlCfg1 (CanIfCtrlCfg): CanIfCtrlId=0, CanIfCtrlWakeupSupport=true, CanIfCtrlCanCtrlRef=CanController1
    CanIfInitCfg: CanIfInitCfgSet=main_canif_config
      CanIfBufferCfg: CanIfBufferSize=0, CanIfBufferHthRef=CanIfHthCfg1
      CanIfInitHohCfg: CanIfInitRefCfgSet=CanConfigSet
        CanIfHthCfg1 (CanIfHthCfg): CanIfHthCanCtrlIdRef=CanIfCtrlCfg1, CanIfHthIdSymRef=CanHardwareObject1
      CanIfTxPduCfg_0 (CanIfTxPduCfg):
        CanIfTxPduCanId = 2
        CanIfTxPduCanIdType = STANDARD_CAN
        CanIfTxPduDlc = 4
        CanIfTxPduId = 0
        CanIfTxPduPnFilterPdu = false
        CanIfTxPduReadNotifyStatus = true
        CanIfTxPduType = STATIC
        CanIfTxPduUserTxConfirmationName = PduR_CanIfTxConfirmation
        CanIfTxPduUserTxConfirmationUL = PDUR
        CanIfTxPduBufferRef = CanIfBufferCfg
        CanIfTxPduRef = Pdu1
  module config Can: ecuc-def-edition=4.2.0, implementation-config-variant=VARIANT-PRE-COMPILE
    CanConfigSet
      CanHardwareObject1 (CanHardwareObject): CanHandleType=FULL, CanObjectType=TRANSMIT, CanIdType=STANDARD, CanIdValue=0, CanObjectId=0, CanControllerRef=CanController1
      CanController1 (CanController):
        CanControllerId = 0
        CanBusoffProcessing = INTERRUPT
        CanControllerActivation = false
        CanControllerBaseAddress = 0
        CanRxProcessing = INTERRUPT
        CanTxProcessing = INTERRUPT
        CanWakeupProcessing = INTERRUPT
        CanWakeupSupport = false
        CanWakeupSourceRef = EcuMWakeupSource1
        CanControllerDefaultBaudrate = CanControllerBaudrateConfig_0
        CanControllerBaudrateConfig_0 (CanControllerBaudrateConfig): CanControllerBaudRate=500, CanControllerPropSeg=0, CanControllerSeg1=0, CanControllerSeg2=255, CanControllerSyncJumpWidth=0
        CanControllerBaudrateConfig_1 (CanControllerBaudrateConfig): CanControllerBaudRate=250, CanControllerPropSeg=0, CanControllerSeg1=0, CanControllerSeg2=255, CanControllerSyncJumpWidth=0
    CanGeneral:
      CanIndex = 0
      CanChangeBaudrateApi = true
      CanDevErrorDetection = true
      CanHardwareCancellation = false
      CanIdenticalIdCancellation = false
      CanMainFunctionModePeriod = 0.2
      CanMultiplexedTransmission = false
      CanVersionInfoApi = true
      CanTimeoutDuration = 0.1
      CanSupportTTCANRef = CanIfPrivateCfg
      CanCounterRef = MAIN_HW_COUNTER
      CanMainFunctionRWPeriods: CanMainFunctionReadPeriod=0.1, CanMainFunctionWritePeriod=0.0
  module config EcuM: ecuc-def-edition=4.2.0, implementation-config-variant=VARIANT-PRE-COMPILE
    EcuMConfiguration
      EcuMCommonConfiguration
        EcuMWakeupSource1 (EcuMWakeupSource): EcuMWakeupSourceId=0
  module config Rte: ecuc-def-edition=4.2.0, implementation-config-variant=VARIANT-PRE-COMPILE
    RteBswGeneral: RteSchMVersionInfoApi=false, RteUseComShadowSignalApi=false
    RteGeneration:
      RteCalibrationSupport = NONE
      RteCodeVendorId = 65
      RteDevErrorDetect = true
      RteDevErrorDetectUninit = true
      RteGenerationMode = COMPATIBILITY_MODE
      RteMeasurementSupport = false
      RteOptimizationMode = MEMORY
      RteValueRangeCheckEnabled = false
      RteVfbTraceEnabled = false
    RteInitializationBehavior: RteInitializationStrategy=RTE_INITIALIZATION_STRATEGY_NONE, RteSectionInitializationPolicy=NO-INIT
    SWCI1 (RteSwComponentInstance): RteSoftwareComponentInstanceRef=SWC1
      TimingEvent1 (RteEventToTaskMapping): RteImmediateRestart=false, RtePositionInTask=1, RteActivationOffset=0.1, RteEventRef=TimingEvent, RteMappedToTaskRef=TASK1, RteUsedOsAlarmRef=ALARM1
    RteOsInteraction
      RteUsedOsActivation1 (RteUsedOsActivation): RteExpectedActivationOffset=0.1, RteExpectedTickDuration=0.1, RteActivationOsAlarmRef=ALARM1
      RteUsedOsActivation2 (RteUsedOsActivation): RteExpectedActivationOffset=0.1, RteExpectedTickDuration=0.1, RteActivationOsAlarmRef=ALARM2
    3 x RteBswModuleInstance:
      RteBswModuleInstance_com: RteBswImplementationRef=bswImplementation0
        3 x RteBswExclusiveAreaImpl, all with RteExclusiveAreaImplMechanism=OS_RESOURCE:
          RteBswExclusiveAreaImpl_exclusiveArea{0..2}: RteBswExclusiveAreaOsResourceRef=COM_REENTRANT{0..2}, RteBswExclusiveAreaRef=Reentrant_{0..2}
        RteBswEventToTaskMapping_timingEvent1 (RteBswEventToTaskMapping):
          RteBswImmediateRestart = 0
          RteBswPositionInTask = 0
          RteBswActivationOffset = 0.1
          RteBswEventRef = TimingEvent_MainFunctionRx
          RteBswMappedToTaskRef = SCHM_TASK
          RteBswUsedOsAlarmRef = ALARM2
        RteBswEventToTaskMapping_timingEvent2 (RteBswEventToTaskMapping):
          RteBswImmediateRestart = 0
          RteBswPositionInTask = 1
          RteBswActivationOffset = 0.1
          RteBswEventRef = TimingEvent_MainFunctionTx
          RteBswMappedToTaskRef = SCHM_TASK
          RteBswUsedOsAlarmRef = ALARM2
      RteBswModuleInstance_can: RteBswImplementationRef=bswImplementation1
        RteBswExclusiveAreaImpl_exclusiveArea3 (RteBswExclusiveAreaImpl): RteExclusiveAreaImplMechanism=OS_RESOURCE, RteBswExclusiveAreaOsResourceRef=CAN_REENTRANT, RteBswExclusiveAreaRef=Reentrant
      RteBswModuleInstance_canif: RteBswImplementationRef=bswImplementation2
        RteBswExclusiveAreaImpl_exclusiveArea4 (RteBswExclusiveAreaImpl): RteExclusiveAreaImplMechanism=OS_RESOURCE, RteBswExclusiveAreaOsResourceRef=CANIF_REENTRANT0, RteBswExclusiveAreaRef=Reentrant_0
        RteBswExclusiveAreaImpl_exclusiveArea5 (RteBswExclusiveAreaImpl): RteExclusiveAreaImplMechanism=OS_RESOURCE, RteBswExclusiveAreaOsResourceRef=CANIF_REENTRANT1, RteBswExclusiveAreaRef=Reentrant_1
